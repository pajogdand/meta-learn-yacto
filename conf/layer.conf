## conf/layer.conf
```bitbake
# We have a conf and classes directory, add to BBPATH
BBPATH .= ":${LAYERDIR}"

# We have recipes-* directories, add to BBFILES
BBFILES += "${LAYERDIR}/recipes-*/*/*.bb \
            ${LAYERDIR}/recipes-*/*/*.bbappend"

BBFILE_COLLECTIONS += "meta-learn-yacto"
BBFILE_PATTERN_meta-learn-yacto = "^${LAYERDIR}/"
BBFILE_PRIORITY_meta-learn-yacto = "6"

LAYERDEPENDS_meta-learn-yacto = "core"
LAYERSERIES_COMPAT_meta-learn-yacto = "thud"
```
